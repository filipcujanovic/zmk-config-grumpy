## config/boards/shields/grumpy/Kconfig.defconfig
```kconfig
# Copyright (c) 2022 The ZMK Contributors
# SPDX-License-Identifier: MIT

if SHIELD_GRUMPY

config ZMK_KEYBOARD_NAME
    default "grumpy"

config CONFIG_ZMK_SETTINGS_RESET_ON_START
    default y

endif
```
